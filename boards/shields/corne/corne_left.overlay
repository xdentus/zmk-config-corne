#include "corne.dtsi"

&kscan0 {
    col-gpios
        = <&pro_micro D19 GPIO_ACTIVE_HIGH>
        , <&pro_micro D18 GPIO_ACTIVE_HIGH>
        , <&pro_micro D15 GPIO_ACTIVE_HIGH>
        , <&pro_micro D14 GPIO_ACTIVE_HIGH>
        , <&pro_micro D16 GPIO_ACTIVE_HIGH>
        , <&pro_micro D10 GPIO_ACTIVE_HIGH>
        ;
};