#include "corne.dtsi"

&default_transform {
    col-offset = <6>;
};

&kscan0 {
    col-gpios
        = <&pro_micro x GPIO_ACTIVE_HIGH>
        , <&pro_micro x GPIO_ACTIVE_HIGH>
        , <&pro_micro x GPIO_ACTIVE_HIGH>
        , <&pro_micro x GPIO_ACTIVE_HIGH>
        , <&pro_micro x GPIO_ACTIVE_HIGH>
        , <&pro_micro x GPIO_ACTIVE_HIGH>
        ;
};